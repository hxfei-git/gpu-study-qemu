## hw/remote/Kconfig
```kconfig
config REMOTE_MACHINE
    bool
    depends on PCI && PCI_EXPRESS
    select REMOTE_PCIHOST

config MULTIPROCESS
    bool
    depends on PCI && PCI_EXPRESS && KVM
    select REMOTE_MACHINE

config VFIO_USER_SERVER
    bool
    depends on PCI && PCI_EXPRESS
    select REMOTE_MACHINE
```
